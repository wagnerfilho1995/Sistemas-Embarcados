## CMakeLists.txt
```
cmake_minimum_required(VERSION 3.13.1)

include($ENV{ZEPHYR_BASE}/cmake/app/boilerplate.cmake NO_POLICY_SCOPE)
project(button_2.0)


list(APPEND HEADERS
    "${PROJECT_BINARY_DIR}/include/generated"
    "${PROJECT_BINARY_DIR}/zephyr/include/generated"
    "${PROJECT_SOURCE_DIR}/include"
    "${PROJECT_SOURCE_DIR}/include/input"
    "${PROJECT_SOURCE_DIR}/include/output"
    )

list(APPEND SOURCES
    "${PROJECT_SOURCE_DIR}/src/main.c"
    "${PROJECT_SOURCE_DIR}/src/input.c"
    "${PROJECT_SOURCE_DIR}/src/output.c"
)

include_directories(${HEADERS})
target_sources(app PRIVATE ${SOURCES})
```

## prj.conf
```kconfig
# Enable debug
CONFIG_PRINTK=y
```

## src/main.c
```c
#include <zephyr.h>
#include <device.h>
#include <gpio.h>

#include "input.h"
#include "output.h"

/* Leds */
#define LED0_PORT LED0_GPIO_CONTROLLER
#define LED1_PORT LED1_GPIO_CONTROLLER
#define LED2_PORT LED2_GPIO_CONTROLLER
#define LED3_PORT LED3_GPIO_CONTROLLER

#define LED0_PIN LED0_GPIO_PIN
#define LED1_PIN LED1_GPIO_PIN
#define LED2_PIN LED2_GPIO_PIN
#define LED3_PIN LED3_GPIO_PIN

/* Buttons */
#define SW0_PORT SW0_GPIO_CONTROLLER
#define SW1_PORT SW1_GPIO_CONTROLLER
#define SW2_PORT SW2_GPIO_CONTROLLER
#define SW3_PORT SW3_GPIO_CONTROLLER

#define SW0_PIN SW0_GPIO_PIN
#define SW1_PIN SW1_GPIO_PIN
#define SW2_PIN SW2_GPIO_PIN
#define SW3_PIN SW3_GPIO_PIN

/* GPIO interrupt flags */
#define INTERRUPT GPIO_INT
#define FALLING_EDGE (GPIO_INT_EDGE | GPIO_INT_ACTIVE_LOW)
#define DEBOUNCE GPIO_INT_DEBOUNCE
#define PULL_UP GPIO_PUD_PULL_UP

#define SW_GPIO_FLAGS (INTERRUPT | FALLING_EDGE | DEBOUNCE | PULL_UP)

/* Sleep time */
#define SLEEP_TIME 500

output_t *led0, *led1, *led2, *led3;
//struct device *led0, *led1, *led2, *led3;

void button_pressed(struct device *gpiob, struct gpio_callback *cb,
                    u32_t pins){
  printk("Button 1 pressed at %d\n", k_cycle_get_32());
}

void led(output_t *led, u32_t pin, char *port){
    output_open(led, port);
    output_configure(led, pin, GPIO_DIR_OUT);  
}

void button(input_t *button, u32_t pin, char *port){
    input_open(button, port);
    input_configure(button, pin, SW_GPIO_FLAGS, button_pressed);
}

void main(void) {
    
    //struct device *sw0, *sw1, *sw2, *sw3;
    input_t *btn0, *btn1, *btn2, *btn3;

    // Creating Leds and Buttons
    led(led0, LED0_PIN, LED0_PORT);
    led(led1, LED1_PIN, LED1_PORT);
    led(led2, LED2_PIN, LED2_PORT);
    led(led3, LED3_PIN, LED3_PORT);

    button(btn0, SW0_PIN, SW0_PORT);
    button(btn1, SW1_PIN, SW1_PORT);
    button(btn2, SW2_PIN, SW2_PORT);
    button(btn3, SW3_PIN, SW3_PORT);

    /* Main loop */
    while(1) {
        u32_t val = 0U;

        input_read(btn0, &val);
        input_read(btn1, &val);
        input_read(btn2, &val);
        input_read(btn3, &val);

        k_sleep(SLEEP_TIME);
    }
}
```

## include/input.h
```c
/**
 * @file   input.h
 * @author Lucas Peixoto <lucaspeixotoac@gmail.com>
 * @date   Mon Jul  8 08:07:18 2019
 * 
 * @brief  Header file para o driver input
 * 
 * 
 */

#ifndef _INPUT_H_
#define _INPUT_H_

#include <gpio.h>

struct input {
    struct device *device;
    struct gpio_callback gpio_callback;
    char *dev_label;
    u32_t pin;
};

typedef struct input input_t;

/** 
 * Essa função tem como objetivo iniciar o device do driver
 * de entrada.
 * @param in 
 *
 * @return 
 */
int input_open(input_t *in, char *dev_label);

/** 
 * Essa função tem como objetivo configurar o pino de entrada.
 *
 * @param in 
 * @param pin 
 * @param flags 
 * @param cb 
 *
 * @return 
 */
int input_configure(input_t *in, u32_t pin, int flags, gpio_callback_handler_t cb);

/** 
 * Essa função tem como objetivo fazer uma leitura do pino
 * de entrada.
 * @param in 
 * @param state 
 *
 * @return 
 */
int input_read(input_t *in, u32_t *state);

#endif
```

## include/output.h
```c
/**
 * @file   output.h
 * @author Lucas Peixoto <lucaspeixotoac@gmail.com>
 * @date   Mon Jul  8 08:04:22 2019
 * 
 * @brief  Header file para o driver output.
 * 
 * 
 */

#ifndef _OUTPUT_H_
#define _OUTPUT_H_

#include <device.h>

struct output {
    struct device *device;
    char *dev_label;
    u32_t pin;
    u8_t state;
};

typedef struct output output_t;

/** 
 * Essa função tem como objetivo iniciar o driver output,
 * ou seja, iniciar o device. 
 * @param out 
 *
 * @return 
 */
int output_open(output_t *out, char *dev_label);

/** 
 * Essa função tem como objetivo configurar o pino de saída
 * de acordo com suas flags.
 * @param out 
 * @param pin 
 * @param flags 
 *
 * @return 
 */
int output_configure(output_t *out, u32_t pin, int flags);

/** 
 * Essa função tem como objetivo setar o estado do pino de
 * saída para algum valor.
 * @param out 
 * @param value 
 *
 * @return 
 */
int output_set(output_t *out, u8_t value);

#endif
```

## src/input.c
```c
#include "input.h"

/** 
 * Essa função tem como objetivo iniciar o device do driver
 * de entrada.
 * @param in 
 *
 * @return 
 */
int input_open(input_t *in, char *dev_label) {
    in->dev_label = dev_label;
    in->device = device_get_binding(in->dev_label);
    return 0;
}

/** 
 * Essa função tem como objetivo configurar o pino de entrada.
 *
 * @param in 
 * @param pin 
 * @param flags 
 * @param cb 
 *
 * @return 
 */
int input_configure(input_t *in, u32_t pin, int flags, gpio_callback_handler_t cb) {
    in->pin = pin;
    gpio_pin_configure(in->device, in->pin, flags);

    gpio_init_callback(&in->gpio_callback, cb, in->gpio_callback.pin_mask | BIT(in->pin));
    gpio_add_callback(in->device, &in->gpio_callback);
    gpio_pin_enable_callback(in->device, in->pin);

    return 0;
}

/** 
 * Essa função tem como objetivo fazer uma leitura do pino
 * de entrada.
 * @param in 
 * @param state 
 *
 * @return 
 */
int input_read(input_t *in, u32_t *state) {
    gpio_pin_read(in->device, in->pin, state);
    return 0;
}
```

## src/output.c
```c
#include "output.h"
#include <gpio.h>

/** 
 * Essa função tem como objetivo iniciar o driver output,
 * ou seja, iniciar o device. 
 * @param out 
 *
 * @return 
 */

int output_open(output_t *out, char *dev_label) {
    out->dev_label = dev_label;
    out->device = device_get_binding(out->dev_label);
    if(!out->device){
        printk("error\n");
        return 1; // Fazer uma função de tratamento do erro
    }
    return 0;
}

/** 
 * Essa função tem como objetivo configurar o pino de saída
 * de acordo com suas flags.
 * @param out 
 * @param pin 
 * @param flags 
 *
 * @return 
 */
int output_configure(output_t *out, u32_t pin, int flags) {
    out->pin = pin;
    gpio_pin_configure(out->device, out->pin, flags);
    return 0;
}

/** 
 * Essa função tem como objetivo setar o estado do pino de
 * saída para algum valor.
 * @param out 
 * @param value 
 *
 * @return 
 */
int output_set(output_t *out, u8_t value) {
    out->state = value;
    gpio_pin_write(out->device, out->pin, out->state);
    return 0;
}
```
