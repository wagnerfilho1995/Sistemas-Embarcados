## CMakeLists.txt
```
cmake_minimum_required(VERSION 3.13.1)

include($ENV{ZEPHYR_BASE}/cmake/app/boilerplate.cmake NO_POLICY_SCOPE)
project(buttonsWithLeds2.0)


list(APPEND HEADERS
    "${PROJECT_BINARY_DIR}/include/generated"
    "${PROJECT_BINARY_DIR}/zephyr/include/generated"
    "${PROJECT_SOURCE_DIR}/include"
    "${PROJECT_SOURCE_DIR}/include/setup"
    "${PROJECT_SOURCE_DIR}/include/input"
    "${PROJECT_SOURCE_DIR}/include/output"
    )

list(APPEND SOURCES
    "${PROJECT_SOURCE_DIR}/src/main.c"
    "${PROJECT_SOURCE_DIR}/src/input.c"
    "${PROJECT_SOURCE_DIR}/src/output.c"
)

include_directories(${HEADERS})
target_sources(app PRIVATE ${SOURCES})
```

## prj.conf
```kconfig
CONFIG_PRINTK=y
CONFIG_GPIO=y
CONFIG_SHELL=y
CONFIG_DEVICE_SHELL=y
CONFIG_KERNEL_SHELL=y
```

## src/main.c
```c
#include <zephyr.h>
#include <device.h>
#include <gpio.h>
#include <misc/printk.h>
#include <shell/shell.h>

#include "setup.h"
#include "input.h"
#include "output.h"

// Structs globais de saida do tipo output_t
output_t led_zero, led_one, led_two, led_three; // Leds

/* Comando Shell press -> parametros: (Struct do tipo shell, argc é o numero de argumentos do comando, argv é um array de tring
   contendo os argumentos em si)*/
static int cmd_run_skol(const struct shell *shell, size_t argc, char **argv) {
        
        // 0 - Led aceso
        // 1 - Led apagado
        int state_led = 1;
        int loops = 2;

        // Reproduzir a ação 2 vezes 
        for(int i = 0; i < loops; i++){
            state_led = 1;
            // Inicialmente todos os Leds apagados
            output_set(&led_zero, state_led);
            output_set(&led_one, state_led);
            output_set(&led_two, state_led);
            output_set(&led_three, state_led);

            state_led = 0;
            // Acender no sentido horario
            output_set(&led_zero, state_led);
            k_sleep(SLEEP_TIME);
            output_set(&led_one, state_led);
            k_sleep(SLEEP_TIME);
            output_set(&led_three, state_led);
            k_sleep(SLEEP_TIME);
            output_set(&led_two, state_led);
            k_sleep(SLEEP_TIME);

            // Apague voltando "Backtrack"
            state_led = 1;
            output_set(&led_two, state_led);
            k_sleep(SLEEP_TIME-200);
            output_set(&led_three, state_led);
            k_sleep(SLEEP_TIME)-200;
            output_set(&led_one, state_led);
            k_sleep(SLEEP_TIME-200);
            output_set(&led_zero, state_led);
            k_sleep(SLEEP_TIME-200);
        }
        // Printando no terminal do shell que a ação foi executada
        shell_print(shell, "Os leds que descem redondo!");
        return 0;
}

/* Comando Shell press -> parametros: (Struct do tipo shell, argc é o numero de argumentos do comando, argv é um array de tring
   contendo os argumentos em si)*/
static int cmd_run_press(const struct shell *shell, size_t argc, char **argv) {

        // Acessar: Array de Strings -> String na posição argc+1
        char led = *(*(argv+1));

        switch (led) {
        case '0':
            output_pressed(&led_zero);
            break;
        case '1':
            output_pressed(&led_one);
            break;
        case '2':
            output_pressed(&led_two);
            break;
        case '3':
            output_pressed(&led_three);
            break;
        default:
            shell_print(shell, "Botao invalido");
            return -1;
        }
        // Printando no terminal do shell que a ação foi executada
        shell_print(shell, "Led %c pressionado.", led);
        return 0;
}

// Colocando os comandos criados como subcomandos do run
SHELL_STATIC_SUBCMD_SET_CREATE(sub_run,
    SHELL_CMD_ARG(skol, NULL, "Comando Skol.", cmd_run_skol, 1, NULL),
    SHELL_CMD_ARG(press, NULL, "Comando Press.", cmd_run_press, 2, NULL),
    SHELL_SUBCMD_SET_END
);

// Setando o comando run no root
SHELL_CMD_REGISTER(run, &sub_run, "Comandos Run.", NULL);

// Função para botão pressionado
void button_pressed(struct device *btn, struct gpio_callback *cb, u32_t pins){
    if(pins & BIT(SW0_PIN)) {
        output_pressed(&led_zero);
        printk("Botao 0 pressionado em %d ciclos\n", k_cycle_get_32());
    } else if(pins & BIT(SW1_PIN)) {
        output_pressed(&led_one);
        printk("Botao 1 pressionado em %d ciclos\n", k_cycle_get_32());
    } else if(pins & BIT(SW2_PIN)) {
        output_pressed(&led_two);
        printk("Botao 2 pressionado em %d ciclos\n", k_cycle_get_32());
    } else {
        output_pressed(&led_three);
        printk("Botao 3 pressionado em %d ciclos\n", k_cycle_get_32());
    }
}

// Inicializador Led
void led(output_t *led, u32_t pin, char *port, u8_t state){
    int e = output_open(led, port);
    if(e){
        printk("Alerta: Led para o PIN%d não inicializado.\n", pin);
        return;
    }
    output_configure(led, pin, GPIO_DIR_OUT);
    output_set(led, state);
    printk("Led em PIN%d inicializado.\n", pin);
}

// Inicializador Botão
void button(input_t *button, u32_t pin, char *port){
    int e = input_open(button, port);
    if(e){
        printk("Alerta: Botao para o PIN%d não inicializado.\n", pin);
        return;
    }
    input_configure(button, pin, GPIO_DIR_IN | SW_GPIO_FLAGS, button_pressed);
    printk("Botao em PIN%d inicializado.\n", pin);
}

void main(void) {

    // Structs do tipo input_t representando cada botão
    input_t btn0, btn1, btn2, btn3;

    // Estado inicial dos leds
    u8_t state = 1; // Inicialmente apagados

    // Criando e definindo Leds
    led(&led_zero, led_zero_PIN, led_zero_PORT, state);
    led(&led_one, led_one_PIN, led_one_PORT, state);
    led(&led_two, led_two_PIN, led_two_PORT, state);
    led(&led_three, led_three_PIN, led_three_PORT, state);

    printk("\n");

    // Criando e definindo botoes
    button(&btn0, SW0_PIN, SW0_PORT);
    button(&btn1, SW1_PIN, SW1_PORT);
    button(&btn2, SW2_PIN, SW2_PORT);
    button(&btn3, SW3_PIN, SW3_PORT);

    printk("Aguardando comandos ...\n");
    while(1) {
        u32_t val = 0U;

        input_read(&btn0, &val);
        input_read(&btn1, &val);
        input_read(&btn2, &val);
        input_read(&btn3, &val);

        k_sleep(SLEEP_TIME);
    }
}
```

## include/input.h
```c
/**
 * @file   input.h
 * @author Lucas Peixoto <lucaspeixotoac@gmail.com>
 * @date   Mon Jul  8 08:07:18 2019
 * 
 * @brief  Header file para o driver input
 * 
 * 
 */

#ifndef _INPUT_H_
#define _INPUT_H_

#include <device.h>
#include <gpio.h>

struct input {
    struct device *device;
    struct gpio_callback gpio_callback;
    char *dev_label;
    u32_t pin;
};

typedef struct input input_t;

/** 
 * Essa função tem como objetivo iniciar o device do driver
 * de entrada.
 * @param in 
 *
 * @return 
 */
int input_open(input_t *in, char *dev_label);

/** 
 * Essa função tem como objetivo configurar o pino de entrada.
 *
 * @param in 
 * @param pin 
 * @param flags 
 * @param cb 
 *
 * @return 
 */
int input_configure(input_t *in, u32_t pin, int flags, gpio_callback_handler_t cb);

/** 
 * Essa função tem como objetivo fazer uma leitura do pino
 * de entrada.
 * @param in 
 * @param state 
 *
 * @return 
 */
int input_read(input_t *in, u32_t *state);

#endif
```

## include/output.h
```c
/**
 * @file   output.h
 * @author Lucas Peixoto <lucaspeixotoac@gmail.com>
 * @date   Mon Jul  8 08:04:22 2019
 * 
 * @brief  Header file para o driver output.
 * 
 * 
 */

#ifndef _OUTPUT_H_
#define _OUTPUT_H_

#include <device.h>
#include <gpio.h>


struct output {
    struct device *device;
    char *dev_label;
    u32_t pin;
    u8_t state;
};

typedef struct output output_t;

/** 
 * Essa função tem como objetivo iniciar o driver output,
 * ou seja, iniciar o device. 
 * @param out 
 *
 * @return 
 */
int output_open(output_t *out, char *dev_label);

/** 
 * Essa função tem como objetivo configurar o pino de saída
 * de acordo com suas flags.
 * @param out 
 * @param pin 
 * @param flags 
 *
 * @return 
 */
int output_configure(output_t *out, u32_t pin, int flags);

/** 
 * Essa função tem como objetivo setar o estado do pino de
 * saída para algum valor.
 * @param out 
 * @param value 
 *
 * @return 
 */
int output_set(output_t *out, u8_t value);

/** 
 * Essa função tem como objetivo inverter o estado do pino de
 * saída.
 * @param out 
 *
 * @return 
 */
int output_pressed(output_t *out);

#endif
```

## include/setup.h
```c
// DEFINIÇÕES DOS COMPONENTES DO PROJETO //

// Portas e Pinos dos leds
#define led_zero_PORT LED0_GPIO_CONTROLLER
#define led_one_PORT LED1_GPIO_CONTROLLER
#define led_two_PORT LED2_GPIO_CONTROLLER
#define led_three_PORT LED3_GPIO_CONTROLLER

#define led_zero_PIN LED0_GPIO_PIN
#define led_one_PIN LED1_GPIO_PIN
#define led_two_PIN LED2_GPIO_PIN
#define led_three_PIN LED3_GPIO_PIN


// Portas e Pinos dos botões
#define SW0_PORT SW0_GPIO_CONTROLLER
#define SW1_PORT SW1_GPIO_CONTROLLER
#define SW2_PORT SW2_GPIO_CONTROLLER
#define SW3_PORT SW3_GPIO_CONTROLLER

#define SW0_PIN SW0_GPIO_PIN
#define SW1_PIN SW1_GPIO_PIN
#define SW2_PIN SW2_GPIO_PIN
#define SW3_PIN SW3_GPIO_PIN


// Flags de interrupções do GPIO
#define INTERRUPT GPIO_INT
#define FALLING_EDGE (GPIO_INT_EDGE | GPIO_INT_ACTIVE_LOW)
#define DEBOUNCE GPIO_INT_DEBOUNCE
#define PULL_UP GPIO_PUD_PULL_UP
#define SW_GPIO_FLAGS (INTERRUPT | FALLING_EDGE | DEBOUNCE | PULL_UP)

// Tempo de Sleep
#define SLEEP_TIME 500
```

## src/input.c
```c
#include <gpio.h>

#include "setup.h"
#include "input.h"

//static struct gpio_callback callback;
int input_open(input_t *in, char *dev_label) {
    in->dev_label = dev_label;
    in->device = device_get_binding(in->dev_label);
    if(!in->device){
        printk("Função: input_open (arquivo: input.c).\nFalha na atribução do in->device.\n");
        return 1;
    }
    //printk("input_open done\n");
    return 0;
}

int input_configure(input_t *in, u32_t pin, int flags, gpio_callback_handler_t cb) {
    in->pin = pin;
    gpio_pin_configure(in->device, in->pin, flags);
    gpio_init_callback(&in->gpio_callback, cb, BIT(in->pin));
    gpio_add_callback(in->device, &in->gpio_callback);
    gpio_pin_enable_callback(in->device, in->pin);
    //printk("input_configure done\n");
    return 0;
}

int input_read(input_t *in, u32_t *state) {
    gpio_pin_read(in->device, in->pin, state);
    return 0;
}
```

## src/output.c
```c
#include "output.h"
#include <gpio.h>

#include "setup.h"

int output_open(output_t *out, char *dev_label) {
    out->dev_label = dev_label;
    out->device = device_get_binding(out->dev_label);
    //printk("output_open done\n");
    return 0;
}

int output_configure(output_t *out, u32_t pin, int flags) {
    out->pin = pin;
    gpio_pin_configure(out->device, out->pin, flags);
    //printk("output_configure done\n");
    return 0;
}

int output_set(output_t *out, u8_t value) {
    out->state = value;
    gpio_pin_write(out->device, out->pin, out->state);
    //printk("output_set done\n");
    return 0;
}

int output_pressed(output_t *out) {
    if(out->state == 1) {
        out->state = 0;
        gpio_pin_write(out->device, out->pin, out->state);
    } else {
        out->state = 1;
        gpio_pin_write(out->device, out->pin, out->state);
    }
    //printk("output_pressed done\n");
    return 0;
}
```
